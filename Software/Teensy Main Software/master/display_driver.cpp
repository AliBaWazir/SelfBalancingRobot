/*********************************************************************
This is an example for our Monochrome OLEDs based on SSD1306 drivers

  Pick one up today in the adafruit shop!
  ------> http://www.adafruit.com/category/63_98

This example is for a 128x64 size display using I2C to communicate
3 pins are required to interface (2 I2C and one reset)

Adafruit invests time and resources providing this open source code, 
please support Adafruit and open-source hardware by purchasing 
products from Adafruit!

Written by Limor Fried/Ladyada  for Adafruit Industries.  
BSD license, check license.txt for more information
All text above, and the splash screen must be included in any redistribution
*********************************************************************/

#include <SPI.h>
#include <i2c_t3.h>
#include "display_driver.h"





 /****************************************************************************************
 * HARDWARE PORTS ASSIGNMENTS
 ****************************************************************************************/



/****************************************************************************************
 * GLOBAL VARIABLES
 ***************************************************************************************/


/****************************************************************************************
 * DEFINITIONS
 ****************************************************************************************/
#define BOWSERH  37
#define BOWSERW  40
#define DELAYBOWSER 100


#define OLED_RESET 4
Adafruit_SSD1306  display(OLED_RESET); //left display
Adafruit_SSD1306T displayT(OLED_RESET); //right display

#define NUMFLAKES 10
#define XPOS 0
#define YPOS 1
#define DELTAY 2


#define LOGO16_GLCD_HEIGHT 16 
#define LOGO16_GLCD_WIDTH  16 

#define MAX_ANIMATION_FRAME 9

/****************************************************************************************
 * STATIC VARIABLES
 ****************************************************************************************/
static int current_animation_frame                 = 1;
static bool display_driver_initialized             = false;
static bool driver_in_testing_mode                 = false;         // This boolean should be true only in the testing and debugging process

static uint8_t PROGMEM frame_bitmap[128];


static const unsigned char PROGMEM Bowser_1[] = {
0x01, 0x00, 0x98, 0x00, 0x00, 0x02, 0x81, 0x54, 0x00, 0x00, 0x02, 0x8B, 0x73, 0x20, 0x00, 0x04,
0x94, 0x12, 0xD0, 0x00, 0x04, 0xE0, 0x11, 0x38, 0x00, 0x04, 0xE3, 0xE3, 0x74, 0x00, 0x04, 0xFF,
0xE3, 0x08, 0x00, 0x0F, 0xFF, 0xF6, 0x10, 0x00, 0x13, 0xFC, 0x7E, 0x14, 0x00, 0x23, 0xF8, 0x1F,
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0x00, 0x00, 0x00, 0x00, 0x00, 0x00, 
};

static const unsigned char PROGMEM Bowser_2[] = {
0x01, 0x00, 0x98, 0x00, 0x00, 0x02, 0x81, 0x54, 0x00, 0x00, 0x02, 0x8B, 0x73, 0x20, 0x00, 0x04,
0x94, 0x12, 0xD0, 0x00, 0x04, 0xE0, 0x11, 0x28, 0x00, 0x04, 0xE3, 0xE3, 0x74, 0x00, 0x04, 0xFF,
0xE3, 0x08, 0x00, 0x0F, 0xFF, 0xF6, 0x10, 0x00, 0x17, 0xFE, 0x7E, 0x14, 0x00, 0x23, 0xFC, 0x1F,
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0x00, 0x00, 0x00, 0x00, 0x00, 0x00, 
};

static const unsigned char PROGMEM Bowser_3[] = {
0x01, 0x00, 0x98, 0x00, 0x00, 0x02, 0x81, 0x54, 0x00, 0x00, 0x02, 0x8B, 0x73, 0x20, 0x00, 0x04,
0x94, 0x12, 0xD0, 0x00, 0x04, 0xE0, 0x11, 0x28, 0x00, 0x04, 0xE3, 0xE3, 0x74, 0x00, 0x04, 0xFF,
0xE3, 0x08, 0x00, 0x0F, 0xFF, 0xF6, 0x10, 0x00, 0x17, 0xFE, 0x7E, 0x14, 0x00, 0x23, 0xFC, 0x1F,
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0x00, 0x00, 0x00, 0x00, 0x00, 0x00, 
};

static const unsigned char PROGMEM Bowser_4[] = {
0x00, 0x00, 0x00, 0x00, 0x00, 0x00, 0x00, 0x00, 0x00, 0x00, 0x00, 0x00, 0x00, 0x00, 0x00, 0x00,
0x00, 0x00, 0x00, 0x00, 0x00, 0x00, 0x00, 0x00, 0x00, 0x00, 0x00, 0x00, 0x00, 0x00, 0x00, 0x00,
0x00, 0x00, 0x00, 0x00, 0x20, 0x13, 0x00, 0x00, 0x00, 0x50, 0x2A, 0x80, 0x00, 0x00, 0x51, 0x6E,
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0x00, 0x00, 0x00, 0x00, 0x00, 0x00, 0x00, 0x00, 0x00, 0x00, 0x00, 
};

static const unsigned char PROGMEM Bowser_5[] = {
0x00, 0x00, 0x00, 0x00, 0x00, 0x00, 0x00, 0x00, 0x00, 0x00, 0x00, 0x00, 0x00, 0x00, 0x00, 0x00,
0x00, 0x00, 0x00, 0x00, 0x00, 0x00, 0x00, 0x00, 0x00, 0x00, 0x00, 0x00, 0x00, 0x00, 0x00, 0x00,
0x00, 0x00, 0x00, 0x00, 0x00, 0x00, 0x00, 0x00, 0x00, 0x00, 0x00, 0x00, 0x00, 0x00, 0x00, 0x00,
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0x00, 0x00, 0x00, 0x00, 0x00, 0x00, 0x00, 0x00, 0x00, 0x00, 0x00, 
};

static const unsigned char PROGMEM Bowser_6[] = {
0x00, 0x00, 0x00, 0x00, 0x00, 0x00, 0x00, 0x00, 0x00, 0x00, 0x00, 0x00, 0x00, 0x00, 0x00, 0x00,
0x00, 0x00, 0x00, 0x00, 0x00, 0x00, 0x00, 0x00, 0x00, 0x00, 0x00, 0x00, 0x00, 0x00, 0x00, 0x00,
0x00, 0x00, 0x00, 0x00, 0x00, 0x00, 0x00, 0x00, 0x00, 0x00, 0x00, 0x00, 0x00, 0x00, 0x00, 0x00,
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0x00, 0x00, 0x00, 0x00, 0x00, 0x00, 0x00, 0x00, 0x00, 0x00, 0x00, 
};

const unsigned char PROGMEM CAT[] = {
0xFF, 0xFF, 0xFF, 0xFF, 0xFF, 0xFF, 0xFF, 0xFF, 0xFF, 0xFF, 0xFF, 0xFF, 0xFF, 0xFE, 0xFF, 0xFF,
0xFF, 0xFF, 0xFF, 0xFF, 0xFF, 0xFF, 0xFF, 0xFF, 0xDD, 0xFF, 0xFF, 0xFF, 0xFF, 0xFB, 0x7F, 0xFF,
0xFF, 0xFF, 0xFF, 0xFF, 0xFF, 0xFF, 0xFF, 0xFB, 0x77, 0xFD, 0xFF, 0xFF, 0xFF, 0xFD, 0x6E, 0xFF,
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0xFF, 0xFF, 0xFF, 0xFF, 0xFF, 0xFF, 0xFD, 0xFF, 0xFF, 0xF7, 0xBF, 0xEF, 0xFF, 0xFF, 0xFF, 0xFF
};

const unsigned char PROGMEM EYE2 [] = {
0x00, 0x00, 0x00, 0x7F, 0xFE, 0x00, 0x00, 0x00, 0x00, 0x00, 0x07, 0xFF, 0xFF, 0xC0, 0x00, 0x00,
0x00, 0x00, 0x1F, 0xF0, 0x1F, 0xF8, 0x00, 0x00, 0x00, 0x00, 0x7F, 0x00, 0x00, 0xFE, 0x00, 0x00,
0x00, 0x01, 0xF8, 0x00, 0x00, 0x1F, 0x80, 0x00, 0x00, 0x03, 0xE0, 0x00, 0x00, 0x07, 0xC0, 0x00,
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0x00, 0x00, 0x03, 0xFF, 0xFF, 0x80, 0x00, 0x00, 0x00, 0x00, 0x00, 0x1F, 0xF8, 0x00, 0x00, 0x00
};


////////////////////////////////////////////// EYE1/////////////////////////////////////////////
const uint8_t PROGMEM L_EYE_FRAME_1 [] = {
0x00, 0x00, 0x00, 0x00, 0x00, 0x00, 0x00, 0x00, 0x00, 0x00, 0x00, 0x00, 0x00, 0x00, 0x00, 0x00,
0x00, 0x00, 0x00, 0x00, 0x00, 0x00, 0x00, 0x00, 0x00, 0x00, 0x00, 0x00, 0x00, 0x00, 0x00, 0x00,
0x00, 0x00, 0x00, 0x00, 0x00, 0x00, 0x00, 0x00, 0x00, 0x00, 0x00, 0x00, 0x00, 0x00, 0x00, 0x00,
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0x00, 0x00, 0x00, 0x00, 0x00, 0x00, 0x00, 0x00, 0x00, 0x00, 0x00, 0x00, 0x00, 0x00, 0x00, 0x00
};

const uint8_t PROGMEM L_EYE_FRAME_2 [] = {
0x00, 0x00, 0x00, 0x00, 0x00, 0x00, 0x00, 0x00, 0x00, 0x00, 0x00, 0x00, 0x00, 0x00, 0x00, 0x00,
0x00, 0x00, 0x00, 0x00, 0x00, 0x00, 0x00, 0x00, 0x00, 0x00, 0x00, 0x00, 0x00, 0x00, 0x00, 0x00,
0x00, 0x00, 0x00, 0x00, 0x00, 0x00, 0x00, 0x00, 0x00, 0x00, 0x00, 0x00, 0x00, 0x00, 0x00, 0x00,
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0x00, 0x00, 0x00, 0x00, 0x00, 0x00, 0x00, 0x00, 0x00, 0x00, 0x00, 0x00, 0x00, 0x00, 0x00, 0x00
};

const uint8_t PROGMEM L_EYE_FRAME_3 [] = {
0x00, 0x00, 0x00, 0x00, 0x00, 0x00, 0x00, 0x00, 0x00, 0x00, 0x00, 0x00, 0x00, 0x00, 0x00, 0x00,
0x00, 0x00, 0x00, 0x00, 0x00, 0x00, 0x00, 0x00, 0x00, 0x00, 0x00, 0x00, 0x00, 0x00, 0x00, 0x00,
0x00, 0x00, 0x00, 0x00, 0x00, 0x00, 0x00, 0x00, 0x00, 0x00, 0x00, 0x00, 0x00, 0x00, 0x00, 0x00,
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0x00, 0x00, 0x00, 0x00, 0x00, 0x00, 0x00, 0x00, 0x00, 0x00, 0x00, 0x00, 0x00, 0x00, 0x00, 0x00
};


const uint8_t PROGMEM L_EYE_FRAME_4 [] = {
0x00, 0x00, 0x00, 0x00, 0x00, 0x00, 0x00, 0x00, 0x00, 0x00, 0x00, 0x00, 0x00, 0x00, 0x00, 0x00,
0x00, 0x00, 0x00, 0x00, 0x00, 0x00, 0x00, 0x00, 0x00, 0x00, 0x00, 0x00, 0x00, 0x00, 0x00, 0x00,
0x00, 0x00, 0x00, 0x00, 0x00, 0x00, 0x00, 0x00, 0x00, 0x00, 0x00, 0x00, 0x00, 0x00, 0x00, 0x00,
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0x00, 0x00, 0x00, 0x00, 0x00, 0x00, 0x00, 0x00, 0x00, 0x00, 0x00, 0x00, 0x00, 0x00, 0x00, 0x00
};

const uint8_t PROGMEM L_EYE_FRAME_5 [] = {
0x00, 0x00, 0x00, 0x00, 0x00, 0x00, 0x00, 0x00, 0x00, 0x00, 0x00, 0x00, 0x00, 0x00, 0x00, 0x00,
0x00, 0x00, 0x00, 0x00, 0x00, 0x00, 0x00, 0x00, 0x00, 0x00, 0x00, 0x00, 0x00, 0x00, 0x00, 0x00,
0x00, 0x00, 0x00, 0x00, 0x00, 0x00, 0x00, 0x00, 0x00, 0x00, 0x00, 0x00, 0x00, 0x00, 0x00, 0x00,
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0x00, 0x00, 0x00, 0x00, 0x00, 0x00, 0x00, 0x00, 0x00, 0x00, 0x00, 0x00, 0x00, 0x00, 0x00, 0x00
};

const uint8_t PROGMEM L_EYE_FRAME_6 [] = {
0x00, 0x00, 0x00, 0x00, 0x00, 0x00, 0x00, 0x00, 0x00, 0x00, 0x00, 0x00, 0x00, 0x00, 0x00, 0x00,
0x00, 0x00, 0x00, 0x00, 0x00, 0x00, 0x00, 0x00, 0x00, 0x00, 0x00, 0x00, 0x00, 0x00, 0x00, 0x00,
0x00, 0x00, 0x00, 0x00, 0x00, 0x00, 0x00, 0x00, 0x00, 0x00, 0x00, 0x00, 0x00, 0x00, 0x00, 0x00,
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0x00, 0x00, 0x00, 0x00, 0x00, 0x00, 0x00, 0x00, 0x00, 0x00, 0x00, 0x00, 0x00, 0x00, 0x00, 0x00
};

const uint8_t PROGMEM L_EYE_FRAME_7 [] = {
0x00, 0x00, 0x00, 0x00, 0x00, 0x00, 0x00, 0x00, 0x00, 0x00, 0x00, 0x00, 0x00, 0x00, 0x00, 0x00,
0x00, 0x00, 0x00, 0x00, 0x00, 0x00, 0x00, 0x00, 0x00, 0x00, 0x00, 0x00, 0x00, 0x00, 0x00, 0x00,
0x00, 0x00, 0x00, 0x00, 0x00, 0x00, 0x00, 0x00, 0x00, 0x00, 0x00, 0x00, 0x00, 0x00, 0x00, 0x00,
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0x00, 0x00, 0x00, 0x00, 0x00, 0x00, 0x00, 0x00, 0x00, 0x00, 0x00, 0x00, 0x00, 0x00, 0x00, 0x00
};


const uint8_t PROGMEM L_EYE_FRAME_8 [] = {
0x00, 0x00, 0x00, 0x00, 0x00, 0x00, 0x00, 0x00, 0x00, 0x00, 0x00, 0x00, 0x00, 0x00, 0x00, 0x00,
0x00, 0x00, 0x00, 0x00, 0x00, 0x00, 0x00, 0x00, 0x00, 0x00, 0x00, 0x00, 0x00, 0x00, 0x00, 0x00,
0x00, 0x00, 0x00, 0x00, 0x00, 0x00, 0x00, 0x00, 0x00, 0x00, 0x00, 0x00, 0x00, 0x00, 0x00, 0x00,
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0x00, 0x00, 0x00, 0x00, 0x00, 0x00, 0x00, 0x00, 0x00, 0x00, 0x00, 0x00, 0x00, 0x00, 0x00, 0x00
};


////////////////////////////////// X mark for obstacle//////////////////////////////////////////
const unsigned char black_x [] = {
0x00, 0x00, 0x00, 0x00, 0x00, 0x00, 0x00, 0x00, 0x00, 0x00, 0x00, 0x00, 0x00, 0x00, 0x00, 0x00,
0x00, 0x00, 0x00, 0x00, 0x00, 0x0C, 0x00, 0x00, 0x00, 0x00, 0x00, 0x00, 0x00, 0x00, 0x00, 0x00,
0x00, 0x00, 0x00, 0x00, 0x00, 0x1E, 0x00, 0x00, 0x00, 0x00, 0x00, 0x00, 0x00, 0x00, 0x00, 0x00,
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0x00, 0x00, 0x1F, 0xFF, 0xFF, 0xFF, 0xFF, 0xFF, 0xFF, 0xFF, 0xFF, 0xFF, 0xFF, 0xF8, 0x00, 0x00
};
/****************************************************************************************
 * STATIC FUNCTION PROTOTYPES
 ***************************************************************************************/






 /****************************************************************************************
 * STATIC DEBUG AND TEST FUNCTIONS
 ****************************************************************************************/
static void testdrawchar(void) {
  display.setTextSize(1);
  display.setTextColor(WHITE);
  display.setCursor(0,0);

  for (uint8_t i=0; i < 168; i++) {
    if (i == '\n') continue;
    display.write(i);
    if ((i > 0) && (i % 21 == 0))
      display.println();
  }    
  display.display();
}

static void testdrawcircle(void) {
  for (int16_t i=0; i<display.height(); i+=2) {
    display.drawCircle(display.width()/2, display.height()/2, i, WHITE);
    display.display();
  }
}

static void testfillrect(void) {
  uint8_t color = 1;
  for (int16_t i=0; i<display.height()/2; i+=3) {
    // alternate colors
    display.fillRect(i, i, display.width()-i*2, display.height()-i*2, color%2);
    display.display();
    color++;
  }
}

static void testdrawtriangle(void) {
  for (int16_t i=0; i<min(display.width(),display.height())/2; i+=5) {
    display.drawTriangle(display.width()/2, display.height()/2-i,
                     display.width()/2-i, display.height()/2+i,
                     display.width()/2+i, display.height()/2+i, WHITE);
    display.display();
  }
}

static void testfilltriangle(void) {
  uint8_t color = WHITE;
  for (int16_t i=min(display.width(),display.height())/2; i>0; i-=5) {
    display.fillTriangle(display.width()/2, display.height()/2-i,
                     display.width()/2-i, display.height()/2+i,
                     display.width()/2+i, display.height()/2+i, WHITE);
    if (color == WHITE) color = BLACK;
    else color = WHITE;
    display.display();
  }
}

static void testdrawroundrect(void) {
  for (int16_t i=0; i<display.height()/2-2; i+=2) {
    display.drawRoundRect(i, i, display.width()-2*i, display.height()-2*i, display.height()/4, WHITE);
    display.display();
  }
}

static void testfillroundrect(void) {
  uint8_t color = WHITE;
  for (int16_t i=0; i<display.height()/2-2; i+=2) {
    display.fillRoundRect(i, i, display.width()-2*i, display.height()-2*i, display.height()/4, color);
    if (color == WHITE) color = BLACK;
    else color = WHITE;
    display.display();
  }
}
   
static void testdrawrect(void) {
  for (int16_t i=0; i<display.height()/2; i+=2) {
    display.drawRect(i, i, display.width()-2*i, display.height()-2*i, WHITE);
    display.display();
  }
}

static void testdrawline() {  
  for (int16_t i=0; i<display.width(); i+=4) {
    display.drawLine(0, 0, i, display.height()-1, WHITE);
    display.display();
  }
  for (int16_t i=0; i<display.height(); i+=4) {
    display.drawLine(0, 0, display.width()-1, i, WHITE);
    display.display();
  }
  delay(250);
  
  display.clearDisplay();
  for (int16_t i=0; i<display.width(); i+=4) {
    display.drawLine(0, display.height()-1, i, 0, WHITE);
    display.display();
  }
  for (int16_t i=display.height()-1; i>=0; i-=4) {
    display.drawLine(0, display.height()-1, display.width()-1, i, WHITE);
    display.display();
  }
  delay(250);
  
  display.clearDisplay();
  for (int16_t i=display.width()-1; i>=0; i-=4) {
    display.drawLine(display.width()-1, display.height()-1, i, 0, WHITE);
    display.display();
  }
  for (int16_t i=display.height()-1; i>=0; i-=4) {
    display.drawLine(display.width()-1, display.height()-1, 0, i, WHITE);
    display.display();
  }
  delay(250);

  display.clearDisplay();
  for (int16_t i=0; i<display.height(); i+=4) {
    display.drawLine(display.width()-1, 0, 0, i, WHITE);
    display.display();
  }
  for (int16_t i=0; i<display.width(); i+=4) {
    display.drawLine(display.width()-1, 0, i, display.height()-1, WHITE); 
    display.display();
  }
  delay(250);
}

static void testscrolltext(void) {
  display.setTextSize(2);
  display.setTextColor(WHITE);
  display.setCursor(10,0);
  display.clearDisplay();
  display.println("scroll");
  display.display();
 
  display.startscrollright(0x00, 0x0F);
  delay(2000);
  display.stopscroll();
  delay(1000);
  display.startscrollleft(0x00, 0x0F);
  delay(2000);
  display.stopscroll();
  delay(1000);    
  display.startscrolldiagright(0x00, 0x07);
  delay(2000);
  display.startscrolldiagleft(0x00, 0x07);
  delay(2000);
  display.stopscroll();
}


static void display_driver_test(){
    
    for (int i=0; i<100; i++){
        display.clearDisplay();
        display.drawBitmap(0, 0, Bowser_1,  BOWSERW,  BOWSERH, WHITE);
        display.display();
        delay(100);
            
        display.clearDisplay();
        display.drawBitmap(0, 0, Bowser_2,  BOWSERW,  BOWSERH, WHITE);
        display.display();
        delay(100);
            
        display.clearDisplay();
        display.drawBitmap(0, 0, Bowser_3,  BOWSERW,  BOWSERH, WHITE);
        display.display();
        delay(100);
            
        display.clearDisplay();
        display.drawBitmap(0, 0, Bowser_4,  BOWSERW,  BOWSERH, WHITE);
        display.display();
        delay(100);
            
        display.clearDisplay();
        display.drawBitmap(0, 0, Bowser_5,  BOWSERW,  BOWSERH, WHITE);
        display.display();
        delay(100);
            
        display.clearDisplay();
        display.drawBitmap(0, 0, Bowser_6,  BOWSERW,  BOWSERH, WHITE);
        display.display();
        delay(100);
            
    }
              
}
 
/****************************************************************************************
 * STATIC FUNCTIONS
 ***************************************************************************************/
static bool display_driver_construct_bitmap_from_frame(const int* source_frame){
    bool ret = true;
    int  compressed_frame[128]; // has range of values from 64 to 0;
    int  tmp_byte = 0x00;

    for (int v=0; v< 128; v++){
        compressed_frame[v]= source_frame[v]/16;
    }

    for (int i=64; i>0; i--){          // loop over raws
        for (int j= 0; j<16; j++){     // loop over columns in groups of 8
            tmp_byte = 0x00;
            for (int x= 0; x<8; x++){
                if (compressed_frame[8*j+x]>=i){ //==
                    if (x==0){
                        tmp_byte |=0x80; 
                    } else if (x==1){
                        tmp_byte |=0x40;
                    } else if (x==2){
                        tmp_byte |=0x20;
                    } else if (x==3){
                        tmp_byte |=0x10;
                    } else if (x==4){
                        tmp_byte |=0x08;
                    } else if (x==5){
                        tmp_byte |=0x04;
                    } else if (x==6){
                        tmp_byte |=0x02;
                    } else if (x==7){
                        tmp_byte |=0x01;
                    }
                }
            }

            //store tmp in bitmap
            frame_bitmap[(64-i)*16+j]= tmp_byte;        
            
        }
    }


    return ret;
}

static uint8_t* get_current_animation_frame_bit_map(display_driver_object_identifier_e object_identifier){
    uint8_t* retcode = NULL;
    
    if (object_identifier == WOMAN_EYES_ANIMATION){
        if (current_animation_frame == 1){
            retcode = (uint8_t*) L_EYE_FRAME_1;
        } else if (current_animation_frame == 2){
            retcode = (uint8_t*) L_EYE_FRAME_2;
        }else if (current_animation_frame == 3){
            retcode = (uint8_t*) L_EYE_FRAME_3;
        } else if (current_animation_frame == 4){
            retcode = (uint8_t*) L_EYE_FRAME_4;
        }else if (current_animation_frame == 5){
            retcode = (uint8_t*) L_EYE_FRAME_5;
        }else if (current_animation_frame == 6){
            retcode = (uint8_t*) L_EYE_FRAME_6;
        }else if (current_animation_frame == 7){
            retcode = (uint8_t*) L_EYE_FRAME_7;
        }else if (current_animation_frame == 8){
            retcode = (uint8_t*) L_EYE_FRAME_8;
        } else{
            retcode = (uint8_t*) L_EYE_FRAME_1;
        }
      
    } else if(object_identifier == MAN_EYES_ANIMATION){
      ;
      
    }
    return retcode;
}

static uint8_t* map_object_identifier_to_bitmap(display_driver_object_identifier_e object_identifier){
    uint8_t* retcode = NULL;

    //check if the object is animation or still image
    if(object_identifier<0){
        //get the current frame of the animated object
        retcode= get_current_animation_frame_bit_map(object_identifier);
        
        //increment the current frame count of the animated object or rest it
        current_animation_frame++;
        if (current_animation_frame>MAX_ANIMATION_FRAME){
          current_animation_frame=1;
        }
      
    } else{
        if (object_identifier == X_SIGN){
            retcode= (uint8_t*)black_x;
        } else if (object_identifier == LINEAR_SENSOR_ARRAY_FRAME){
            //display the current frame
            retcode= frame_bitmap;
          
        } else{
            Serial.println("ERROR>> map_object_identifier_to_bitmap: object_identifier is UNKNOWN");
        }

    }

    return retcode;
  
}

/*
static bool display_driver_display_bitmap(uint8_t *bitmap){
    bool ret = true;

    if (!driver_in_testing_mode && bitmap == NULL){
        Serial.println("ERROR>> display_driver_display_bitmap: bitmap is NULL");
        return false;
    }
    
    display.clearDisplay();
    display.drawBitmap(0, 0, bitmap,  128,  64, WHITE);
    display.display();

    return ret;
}
*/

/****************************************************************************************
 * PUBLIC FUNCTIONS
 ***************************************************************************************/
bool display_driver_init(){
    bool ret = true;

    if(!display_driver_initialized){

        // by default, we'll generate the high voltage from the 3.3v line internally! (neat!)
        display.begin(SSD1306_SWITCHCAPVCC, 0x3C);  // initialize with the I2C addr 0x3D (for the 128x64) for the left display
        displayT.begin(SSD1306_SWITCHCAPVCC, 0x3C);  // initialize with the I2C addr 0x3D (for the 128x64) for the right display
        // init done
  
        // Show image buffer on the display hardware.
        // Since the buffer is intialized with an Adafruit splashscreen
        // internally, this will display the splashscreen.
        display.display();
        displayT.display();
        delay(2000);

        display_driver_initialized = true;
    }
    
    return ret;
}

/*
//TODO: do the conversion of frame to bitmap from the driver and then display the bit frame bitmap using its identifier
void display_driver_display_frame(const int* frame_data){
    
    if (frame_data == NULL){
        Serial.println("ERROR>> display_driver_display_frame: frame_data is NULL");
        return;
    }

    // clear any existing data in the frame_bitmap
    memset(frame_bitmap, 0, 128);

    // construct bitmap from the provided frame data
    display_driver_construct_bitmap_from_frame(frame_data);

    //display the custruct bit map
    if (! display_driver_display_bitmap(frame_bitmap)){
        Serial.println("ERROR>> display_driver_display_frame: failed to display bit map");
    }
    
}
*/



bool display_driver_display_object(display_identifier_e display_identifier, display_driver_object_identifier_e object_identifier){
    bool      ret               = true;
    uint8_t*  bitmap_to_display = NULL;

    
    //map the object identifier to its correponding bitmap stored as static array in this file
    bitmap_to_display= map_object_identifier_to_bitmap(object_identifier);
    if (bitmap_to_display ==NULL){
        Serial.println("ERROR>> display_driver_display_object: failed to map the object identifier to its correponding bitmap");
        return false;
    }

    switch (display_identifier){
        case DISPLAY_IDENTIFIER_RIGHT:
            display.clearDisplay();
            display.drawBitmap(0, 0, bitmap_to_display,  128,  64, WHITE);
            display.display();
        break;

        case DISPLAY_IDENTIFIER_LEFT:
            displayT.clearDisplay();
            displayT.drawBitmap(0, 0, bitmap_to_display,  128,  64, WHITE);
            displayT.display();
        break;

        case DISPLAY_IDENTIFIER_BOTH:
            display.clearDisplay();
            display.drawBitmap(0, 0, bitmap_to_display,  128,  64, WHITE);
            display.display();

            displayT.clearDisplay();
            displayT.drawBitmap(0, 0, bitmap_to_display,  128,  64, WHITE);
            displayT.display();
        break;

        default:
            Serial.println("ERROR>> display_driver_display_object: display_identifier has UNKNOWN value");
            ret= false;
        break;
      
    }

    return ret;
}

bool display_driver_construct_bitmap_from_frame_and_display(display_identifier_e display_identifier, const int* frame_data){
    bool ret = true;

    if(frame_data == NULL){
        Serial.println("ERROR>> construct_bitmap_from_frame_and_display: frame_data is NULL");
        return false;
    }

    // clear any existing data in the frame_bitmap
    memset(frame_bitmap, 0, 128);

    // construct bitmap from the provided frame data
    if (display_driver_construct_bitmap_from_frame(frame_data)){
        //display the custructed bit map
        if (!display_driver_display_object(DISPLAY_IDENTIFIER_RIGHT, LINEAR_SENSOR_ARRAY_FRAME)){
            Serial.println("ERROR>> construct_bitmap_from_frame_and_display: display_driver_display_object failed");
            ret= false;
        }
    } else{
        Serial.println("ERROR>> construct_bitmap_from_frame_and_display: display_driver_construct_bitmap_from_frame failed");
        ret= false;
    }

    return ret;
}
